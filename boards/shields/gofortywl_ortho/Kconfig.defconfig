## boards/shields/gofortywl_ortho/Kconfig.defconfig
```kconfig
if SHIELD_GOFORTYWL_ORTHO

config ZMK_KEYBOARD_NAME
    default "GoFortyWL Ortho"

# USB の識別子(VID/PID/製造者/製品名)はここには書かない。default は ZMK 自身の
# 既定値に先を越されて一度も効かない。gofortywl_ortho.conf を見ること。

endif
```

## boards/shields/gofortywl_ortho/Kconfig.shield
```kconfig
config SHIELD_GOFORTYWL_ORTHO
    def_bool $(shields_list_contains,gofortywl_ortho)
```
